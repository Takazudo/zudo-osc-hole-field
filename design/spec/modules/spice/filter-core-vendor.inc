* Derived from filter.py; OTA bias and offset settings are model test fixtures.
.include "design/spec/modules/spice/filter-model/LM13700.MOD"
VP P_12V 0 12
VN N_12V 0 -12
VIN IN_BUFFER 0 DC 0 AC 1
RCORE_R_HP_IN_TOP_0 IN_BUFFER HP_PLUS 40000
RCORE_R_HP_IN_BOTTOM_0 HP_PLUS 0 10000
RCORE_R_HP_BP_0 BP_CORE HP_SUM 50000
RCORE_R_HP_LP_0 LP_CORE HP_SUM 100000
RCORE_R_HP_RES_0 RES_NEG HP_SUM 100000
RCORE_R_HP_FEEDBACK_0 HP_CORE HP_SUM 100000
RCORE_R_BP_ATTEN_TOP_0 HP_CORE BP_OTA_SIGNAL 100000
RCORE_R_BP_ATTEN_BOTTOM_0 BP_OTA_SIGNAL 0 200
RCORE_R_BP_OFFSET_FEED_0 BP_OFFSET_TRIM BP_OFFSET 470000
RCORE_R_BP_OFFSET_RETURN_0 BP_OFFSET 0 1000
RCORE_R_LP_ATTEN_TOP_0 BP_CORE LP_OTA_SIGNAL 100000
RCORE_R_LP_ATTEN_BOTTOM_0 LP_OTA_SIGNAL 0 200
RCORE_R_LP_OFFSET_FEED_0 LP_OFFSET_TRIM LP_OFFSET 470000
RCORE_R_LP_OFFSET_RETURN_0 LP_OFFSET 0 1000
RCORE_R_RES_ATTEN_TOP_0 BP_CORE RES_OTA_SIGNAL 100000
RCORE_R_RES_ATTEN_BOTTOM_0 RES_OTA_SIGNAL 0 200
RCORE_R_RES_OFFSET_FEED_0 RES_OFFSET_TRIM RES_OFFSET 470000
RCORE_R_RES_OFFSET_RETURN_0 RES_OFFSET 0 1000
RCORE_R_DRY_ATTEN_TOP_0 IN_BUFFER DRY_OTA_SIGNAL 100000
RCORE_R_DRY_ATTEN_BOTTOM_0 DRY_OTA_SIGNAL 0 200
RCORE_R_DRY_OFFSET_FEED_0 DRY_OFFSET_TRIM DRY_OFFSET 470000
RCORE_R_DRY_OFFSET_RETURN_0 DRY_OFFSET 0 1000
CCORE_C_BP_INTEGRATOR_0 BP_INT 0 1.5e-10
CCORE_C_LP_INTEGRATOR_0 LP_INT 0 1.5e-10
RCORE_R_RESONANCE_FIXED_0 RES_NEG RESONANCE_TRIM 330000
RCORE_R_RESONANCE_LIMIT_R_0 RES_NEG RES_LIMIT 100000
RCORE_R_DRY_GAIN_0 DRY_CORE DRY_INT 68100
RCORE_general_output_J_F1_IN_LP__R_ISO_A_0 C5d31c8_DRIVE C5d31c8_ISO_MID 499
RCORE_general_output_J_F1_IN_LP__R_ISO_B_0 C5d31c8_ISO_MID LP_TIP 499
RCORE_general_output_J_F1_IN_BP__R_ISO_A_0 C29cc99_DRIVE C29cc99_ISO_MID 499
RCORE_general_output_J_F1_IN_BP__R_ISO_B_0 C29cc99_ISO_MID BP_TIP 499
RCORE_general_output_J_F1_IN_HP__R_ISO_A_0 C2b02f4_DRIVE C2b02f4_ISO_MID 499
RCORE_general_output_J_F1_IN_HP__R_ISO_B_0 C2b02f4_ISO_MID HP_TIP 499
RCORE_general_output_J_F1_IN_OUT__R_ISO_A_0 C56c9d6_DRIVE C56c9d6_ISO_MID 499
RCORE_general_output_J_F1_IN_OUT__R_ISO_B_0 C56c9d6_ISO_MID OUT_TIP 499
ECORE_PACK_OPA4196IDR_2_3 HP_CORE 0 HP_PLUS HP_SUM 1e6
ECORE_PACK_OPA4196IDR_2_4 BP_CORE 0 BP_INT BP_CORE 1e6
ECORE_PACK_OPA4196IDR_3_1 LP_CORE 0 LP_INT LP_CORE 1e6
ECORE_PACK_OPA4196IDR_5_4 RES_NEG 0 0 RES_INT 1e6
ECORE_PACK_OPA4196IDR_6_1 DRY_CORE 0 0 DRY_INT 1e6
ECORE_PACK_OPA4196IDR_8_1 C5d31c8_DRIVE 0 LP_CORE C5d31c8_DRIVE 1e6
ECORE_PACK_OPA4196IDR_8_2 C29cc99_DRIVE 0 BP_CORE C29cc99_DRIVE 1e6
ECORE_PACK_OPA4196IDR_8_3 C2b02f4_DRIVE 0 HP_CORE C2b02f4_DRIVE 1e6
ECORE_PACK_OPA4196IDR_8_4 C56c9d6_DRIVE 0 DRY_CORE C56c9d6_DRIVE 1e6
RRES_TRIM RESONANCE_TRIM RES_INT 243k
VOFF_BP BP_OFFSET_TRIM 0 0.3
VOFF_LP LP_OFFSET_TRIM 0 0.3
VOFF_RES RES_OFFSET_TRIM 0 0.3
VOFF_DRY DRY_OFFSET_TRIM 0 -0.3
XOTA1 BP_IABC NC_1_2 BP_OTA_SIGNAL BP_OFFSET BP_INT N_12V 0 NC_1_8 P_12V LM13700/NS
XOTA2 LP_IABC NC_2_15 LP_OTA_SIGNAL LP_OFFSET LP_INT N_12V 0 NC_2_9 P_12V LM13700/NS
XOTA3 RES_IABC NC_3_2 RES_OTA_SIGNAL RES_OFFSET RES_INT N_12V 0 NC_3_8 P_12V LM13700/NS
XOTA4 DRY_IABC NC_4_15 DRY_OFFSET DRY_OTA_SIGNAL DRY_INT N_12V 0 NC_4_9 P_12V LM13700/NS
IBP P_12V BP_IABC {ibfreq}
ILP P_12V LP_IABC {ibfreq}
IRES P_12V RES_IABC {ibres}
IDRY P_12V DRY_IABC {ibdry}
DCORE_RES_LIMIT_POS0_1 RES_LIMIT RES_POS0 LIMIT_DIODE
DCORE_RES_LIMIT_POS1_1 RES_POS0 RES_POS1 LIMIT_DIODE
DCORE_RES_LIMIT_POS2_1 RES_POS1 RES_POS2 LIMIT_DIODE
DCORE_RES_LIMIT_POS3_1 RES_POS2 RES_POS3 LIMIT_DIODE
DCORE_RES_LIMIT_POS4_1 RES_POS3 RES_POS4 LIMIT_DIODE
DCORE_RES_LIMIT_POS5_1 RES_POS4 RES_POS5 LIMIT_DIODE
DCORE_RES_LIMIT_POS6_1 RES_POS5 RES_POS6 LIMIT_DIODE
DCORE_RES_LIMIT_POS7_1 RES_POS6 RES_INT LIMIT_DIODE
DCORE_RES_LIMIT_NEG0_1 RES_NEG0 RES_LIMIT LIMIT_DIODE
DCORE_RES_LIMIT_NEG1_1 RES_NEG1 RES_NEG0 LIMIT_DIODE
DCORE_RES_LIMIT_NEG2_1 RES_NEG2 RES_NEG1 LIMIT_DIODE
DCORE_RES_LIMIT_NEG3_1 RES_NEG3 RES_NEG2 LIMIT_DIODE
DCORE_RES_LIMIT_NEG4_1 RES_NEG4 RES_NEG3 LIMIT_DIODE
DCORE_RES_LIMIT_NEG5_1 RES_NEG5 RES_NEG4 LIMIT_DIODE
DCORE_RES_LIMIT_NEG6_1 RES_NEG6 RES_NEG5 LIMIT_DIODE
DCORE_RES_LIMIT_NEG7_1 RES_INT RES_NEG6 LIMIT_DIODE
.model LIMIT_DIODE D(IS=1n N=1.8 RS=1)
RLOAD_LP LP_TIP 0 100k
RLOAD_BP BP_TIP 0 100k
RLOAD_HP HP_TIP 0 100k
RLOAD_OUT OUT_TIP 0 100k
